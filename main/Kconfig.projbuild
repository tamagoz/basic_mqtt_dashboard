## main/Kconfig.projbuild
```kconfig
menu "Network Configuration"

    config PCF_I2C_ADDR
        hex "I2C address of pcf8574x"
        default 0x3F

    config I2C_MASTER_SDA
        int "I2C SDA PIN"
        default 4

    config I2C_MASTER_SCL
            int "I2C SCL PIN"
            default 5

    choice CONNECTION_TYPE
        prompt "Select Connection Type"
        default USE_WIFI
        help
            Choose between WiFi or Ethernet W5500.

        config USE_WIFI
            bool "WiFi"

        config USE_ETHERNET
            bool "Ethernet W5500"
    endchoice

    # --- เมนูสำหรับ WiFi ---
    menu "WiFi Settings"
        depends on USE_WIFI

        choice WIFI_MODE
            prompt "WiFi Connection Mode"
            default WIFI_MODE_STATIC
            help
                Select how to get WiFi credentials.

            config WIFI_MODE_STATIC
                bool "Static (Fix SSID/Password)"

            config WIFI_MODE_SMARTCONFIG
                bool "SmartConfig (Via Mobile App)"
        endchoice
        
        config WIFI_SSID
            string "WiFi SSID"
            depends on WIFI_MODE_STATIC
            default "My_WiFi_AP"

        config WIFI_PASSWORD
            string "WiFi Password"
            depends on WIFI_MODE_STATIC
            default "12345678"
    endmenu

    # --- เมนูสำหรับ Ethernet W5500 ---
    menu "Ethernet W5500 Settings"
        depends on USE_ETHERNET

        config ETHER_SPI_HOST
            int "SPI Host (2=SPI2, 3=SPI3)"
            range 2 3
            default 2

        config ETHER_MISO_GPIO
            int "MISO GPIO"
            default 12
        
        config ETHER_MOSI_GPIO
            int "MOSI GPIO"
            default 11

        config ETHER_SCLK_GPIO
            int "SCLK GPIO"
            default 13

        config ETHER_CS_GPIO
            int "CS GPIO"
            default 8
        
        config ETHER_INT_GPIO
            int "INT GPIO"
            default 10

        config ETHER_RST_GPIO
            int "RST GPIO"
            default 9

        choice ETHER_IP_TYPE
            prompt "IP Configuration"
            default ETHER_USE_DHCP
            
            config ETHER_USE_DHCP
                bool "DHCP"

            config ETHER_USE_STATIC
                bool "Static IP"
        endchoice

        config ETHER_STATIC_IP
            string "Static IP Address"
            depends on ETHER_USE_STATIC
            default "192.168.1.100"

        config ETHER_STATIC_NETMASK
            string "Netmask"
            depends on ETHER_USE_STATIC
            default "255.255.255.0"

        config ETHER_STATIC_GW
            string "Gateway"
            depends on ETHER_USE_STATIC
            default "192.168.1.1"
    endmenu

endmenu
```
